## boards/arm/ea_rt1170/Kconfig.board
```kconfig
# Copyright 2024, Embedded Artists
# SPDX-License-Identifier: Apache-2.0

config BOARD_EA_RT1176_KIT_CM7
	bool "Embedded Artists iMX RT1176 CM7"
	depends on SOC_MIMXRT1176_CM7
	select SOC_PART_NUMBER_MIMXRT1176CVM8A

config BOARD_EA_RT1176_KIT_CM4
	bool "Embedded Artists iMX RT1176 CM4"
	depends on SOC_MIMXRT1176_CM4
	select SOC_PART_NUMBER_MIMXRT1176CVM8A
```

## boards/arm/ea_rt1170/ea_rt1176_kit_cm4_defconfig
```kconfig
#
# Copyright 2024, Embedded Artists
#
# SPDX-License-Identifier: Apache-2.0
#

CONFIG_BOARD_EA_RT1176_KIT_CM7=y
CONFIG_SOC_MIMXRT1176_CM4=y
CONFIG_SOC_SERIES_IMX_RT=y
CONFIG_CONSOLE=y
CONFIG_UART_CONSOLE=y
CONFIG_SERIAL=y
CONFIG_GPIO=y
CONFIG_ARM_MPU=y
CONFIG_HW_STACK_PROTECTION=y
CONFIG_PINCTRL=y

CONFIG_DEBUG=y
```
